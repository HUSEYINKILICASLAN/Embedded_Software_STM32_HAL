# file: Flash_Write_and_Read.ioc
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Mcu.Family=STM32F0
Mcu.Name=STM32F030R8Tx
Mcu.Package=LQFP64
PA13.Mode=Serial_Wire
PA13.Signal=SYS_SWDIO
PA14.Mode=Serial_Wire
PA14.Signal=SYS_SWCLK
ProjectManager.HeapSize=0x200
ProjectManager.StackSize=0x400
ProjectManager.TargetToolchain=STM32CubeIDE
RCC.AHBFreq_Value=48000000
RCC.APB1Freq_Value=48000000
RCC.APB1TimFreq_Value=48000000
RCC.HCLKFreq_Value=48000000
RCC.PLLMUL=RCC_PLL_MUL12
RCC.SYSCLKFreq_VALUE=48000000
RCC.SYSCLKSource=RCC_SYSCLKSOURCE_PLLCLK
board=NUCLEO-F030R8

// file: Core/Src/main.c
/* USER CODE BEGIN Header */
/**
 ******************************************************************************
 * @file           : main.c
 * @brief          : Main program body
 ******************************************************************************
 * @attention
 *
 * Copyright (c) 2026 STMicroelectronics.
 * All rights reserved.
 *
 * This software is licensed under terms that can be found in the LICENSE file
 * in the root directory of this software component.
 * If no LICENSE file comes with this software, it is provided AS-IS.
 *
 ******************************************************************************
 */
/* USER CODE END Header */
#include "main.h"

/* USER CODE BEGIN PV */
uint32_t flash_address = 0x0800FC00; // STM32F030R8 son sayfa adresi
uint16_t flash_data = 0x0083;        // Yazmak istediğiniz 16-bitlik veri
uint32_t read_data = 0;              // Sonucu doğrulamak için 32-bit okuma değişkeni
/* USER CODE END PV */

void SystemClock_Config(void);
static void MX_GPIO_Init(void);

/* USER CODE BEGIN 0 */
/**
  * @brief  HAL typedef yapılarını kullanarak kalan alanları sıfırlar ve 16-bit veriyi yazar.
  * @param  address: Yazılacak Flash adresi
  * @param  data: Yazılacak 16-bitlik veri
  * @retval HAL_StatusTypeDef: İşlem durumu sonucu
  */
HAL_StatusTypeDef Write_Flash_16Bit_Typedef(uint32_t address, uint16_t data) {
    HAL_StatusTypeDef status;
    FLASH_EraseInitTypeDef eraseInitStruct;
    uint32_t pageError = 0;

    // 1. Lock and Unlock: FLASH arayüzünün kilidini aç
    HAL_FLASH_Unlock();

    // 2. Monitor/Clear Flags: Eski işlem ve hata bayraklarını temizle
    __HAL_FLASH_CLEAR_FLAG(FLASH_FLAG_EOP | FLASH_FLAG_WRPERR | FLASH_FLAG_PGERR);

    // 3. Erase Function: Typedef struct yapısını doldur ve sayfayı sil
    eraseInitStruct.TypeErase   = FLASH_TYPEERASE_PAGES;
    eraseInitStruct.PageAddress = address;
    eraseInitStruct.NbPages     = 1; // Sadece ilgili 1 sayfayı sil

    status = HAL_FLASHEx_Erase(&eraseInitStruct, &pageError);
    if (status != HAL_OK) {
        HAL_FLASH_Lock(); // Silme başarısızsa kilitle ve çık
        return status;
    }

    // 4. Program Functions:
    // İlk adım: Sizin gönderdiğiniz 16-bitlik veriyi yaz (0x0045)
    status = HAL_FLASH_Program(FLASH_TYPEPROGRAM_HALFWORD, address, data);
    if (status != HAL_OK) {
        HAL_FLASH_Lock();
        return status;
    }

    // İkinci adım: Üst byte'ların 0xFFFF kalmasını önlemek için ardışık adrese 0x0000 yaz
    status = HAL_FLASH_Program(FLASH_TYPEPROGRAM_HALFWORD, address + 2, 0x0000);
    if (status != HAL_OK) {
        HAL_FLASH_Lock();
        return status;
    }

    // 5. Lock and Unlock: İşlem bitince FLASH arayüzünü tekrar kilitle
    HAL_FLASH_Lock();

    return HAL_OK;
}

/**
  * @brief  Flash adresinden tam 32-bit (4 byte) okuma yapar.
  * @param  address: Okunacak Flash adresi
  * @retval 32-bitlik tam veri
  */
uint32_t Read_Flash_32Bit_Typedef(uint32_t address) {
    return *(volatile uint32_t*)address;
}
/* USER CODE END 0 */

int main(void)
{

	/* MCU Konfigürasyonu */
		HAL_Init();
		SystemClock_Config();
		MX_GPIO_Init();

		/* USER CODE BEGIN 2 */
		// Flash işlemlerimizi tetikliyoruz
		if (Write_Flash_16Bit_Typedef(flash_address, flash_data) == HAL_OK) {
			read_data = Read_Flash_32Bit_Typedef(flash_address); // Sonuç kararlı bir şekilde: 0x00000045
		}
		/* USER CODE END 2 */

		/* Sonsuz Döngü */
		while (1) {

		}
}

void SystemClock_Config(void)
{
  RCC_OscInitTypeDef RCC_OscInitStruct = {0};
  RCC_ClkInitTypeDef RCC_ClkInitStruct = {0};

  /** Initializes the RCC Oscillators according to the specified parameters
  * in the RCC_OscInitTypeDef structure.
  */
  RCC_OscInitStruct.OscillatorType = RCC_OSCILLATORTYPE_HSI;
  RCC_OscInitStruct.HSIState = RCC_HSI_ON;
  RCC_OscInitStruct.HSICalibrationValue = RCC_HSICALIBRATION_DEFAULT;
  RCC_OscInitStruct.PLL.PLLState = RCC_PLL_ON;
  RCC_OscInitStruct.PLL.PLLSource = RCC_PLLSOURCE_HSI;
  RCC_OscInitStruct.PLL.PLLMUL = RCC_PLL_MUL12;
  RCC_OscInitStruct.PLL.PREDIV = RCC_PREDIV_DIV1;
  if (HAL_RCC_OscConfig(&RCC_OscInitStruct) != HAL_OK)
  {
    Error_Handler();
  }

  /** Initializes the CPU, AHB and APB buses clocks
  */
  RCC_ClkInitStruct.ClockType = RCC_CLOCKTYPE_HCLK|RCC_CLOCKTYPE_SYSCLK
                              |RCC_CLOCKTYPE_PCLK1;
  RCC_ClkInitStruct.SYSCLKSource = RCC_SYSCLKSOURCE_PLLCLK;
  RCC_ClkInitStruct.AHBCLKDivider = RCC_SYSCLK_DIV1;
  RCC_ClkInitStruct.APB1CLKDivider = RCC_HCLK_DIV1;

  if (HAL_RCC_ClockConfig(&RCC_ClkInitStruct, FLASH_LATENCY_1) != HAL_OK)
  {
    Error_Handler();
  }
}

static void MX_GPIO_Init(void)
{

  /* GPIO Ports Clock Enable */
  __HAL_RCC_GPIOA_CLK_ENABLE();

}

void Error_Handler(void)
{
	__disable_irq();
	while (1) {
	}
}
